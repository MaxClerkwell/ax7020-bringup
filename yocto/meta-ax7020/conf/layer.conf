## yocto/meta-ax7020/conf/layer.conf
```bitbake
# Layer configuration for meta-ax7020

BBPATH .= ":${LAYERDIR}"
BBFILES += "${LAYERDIR}/recipes-*/*/*.bb ${LAYERDIR}/recipes-*/*/*.bbappend"

BBFILE_COLLECTIONS += "ax7020"
BBFILE_PATTERN_ax7020 = "^${LAYERDIR}/"
BBFILE_PRIORITY_ax7020 = "10"

LAYERDEPENDS_ax7020 = "core xilinx xilinx-bsp"
LAYERSERIES_COMPAT_ax7020 = "scarthgap"
```
